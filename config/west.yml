## config/west.yml
```yaml
manifest:
  remotes:
    - name: zmkfirmware
      url-base: https://github.com/zmkfirmware
    - name: urob
      url-base: https://github.com/urob

  projects:
    - name: zmk
      remote: zmkfirmware
      revision: edf5c0814fd3ea202e43aad2d68fd32e882a518c # v0.3.0
      import: app/west.yml

    - name: zmk-unicode
      remote: urob
      revision: 866602c99e4a5a0a61d2c1dcf6ecd0fd5e221c0a # v0.3.0

  self:
    path: config
```
